## conf/layer.conf
```bitbake
# meta-edge-ai/conf/layer.conf

BBPATH .= ":${LAYERDIR}"

BBFILES += " \
    ${LAYERDIR}/recipes-*/*/*.bb \
    ${LAYERDIR}/recipes-*/*/*.bbappend \
"

BBFILE_COLLECTIONS += "meta-edge-ai"
BBFILE_PATTERN_meta-edge-ai = "^${LAYERDIR}/"
BBFILE_PRIORITY_meta-edge-ai = "10"

LAYERDEPENDS_meta-edge-ai = "core freescale-layer"
LAYERSERIES_COMPAT_meta-edge-ai = "scarthgap"
```
